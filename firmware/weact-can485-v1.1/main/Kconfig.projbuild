## firmware/weact-can485-v1.1/main/Kconfig.projbuild
```kconfig
menu "WeAct CAN485 V1.1 diagnostics"

config WEACT_DUMP_INTERRUPT_ALLOCATION
    bool "Dump the interrupt allocation table after vehicle I/O startup"
    default n
    help
        Prints esp_intr_dump() from the core-1 vehicle I/O startup task once
        the TWAI, RMT and SPI drivers are installed, so a diagnostic build can
        confirm which core each interrupt was allocated on (ADR-0004). Leave
        this off in vehicle builds.

config WEACT_CAN_FRESHNESS_DEBUG
    bool "Enable bounded CAN freshness diagnostic logger"
    default n
    help
        Starts a low-priority diagnostic task that polls the opt-in Mazda
        telemetry snapshots and read-only TWAI status. It emits one compact
        summary every five seconds and bounded Fresh-to-Stale records. It does
        not change acquisition, decoding, freshness, publication, LED, or
        receive-only behavior. Leave this off for normal vehicle images.

config WEACT_CAN_TELEMETRY_PROFILING
    bool "Enable bounded telemetry stage profiling"
    default n
    help
        Adds a fixed-size five-second wall-clock histogram for queue wait,
        pre-decode due service, decode, diagnostics, publication, notification,
        lighting, and total synchronous telemetry processing. A low-priority
        task emits one summary per completed interval. It does not emit
        per-frame output and does not measure task CPU time. Leave this off for
        normal vehicle images.

config WEACT_CAN_FREERTOS_RUNTIME_STATS
    bool "Enable five-second FreeRTOS task runtime diagnostics"
    default n
    select FREERTOS_GENERATE_RUN_TIME_STATS
    select FREERTOS_VTASKLIST_INCLUDE_COREID
    help
        Starts a low-priority diagnostic task that calls uxTaskGetSystemState()
        every five seconds and reports interval CPU share, task priority, core
        affinity, and stack high-water marks. It also correlates the summary
        with telemetry work-budget pause counts. This enables the global
        FreeRTOS runtime-stat counters and trace-facility task metadata. The
        ESP timer runtime-stat clock must remain selected. Leave this off for
        normal vehicle images.

config WEACT_CAN_TELEMETRY_BENCHMARK
    bool "Run the synthetic telemetry workload at boot"
    default n
    help
        Selects a benchmark-only app entrypoint that feeds a fixed synthetic
        frame sequence through the Mazda telemetry Runtime. It does not start
        TWAI, CAN acquisition, BLE, or LED rendering. Compare equivalent
        firmware builds with WEACT_CAN_TELEMETRY_PROFILING disabled and
        enabled. Leave this off for normal vehicle images.

endmenu
```
